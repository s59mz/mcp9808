/dts-v1/;
/plugin/;

/ {
	compatible = "brcm,bcm2711";

	fragment@1 {
		target = <&i2c1>;
		__overlay__ {
			status = "okay";

			mcp9808@18 {
				compatible = "mz,mcp9808mz";
				reg = <0x18>;
			};
		};
	};
};
